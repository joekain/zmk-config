/*
 * Copyright (c) 2024 Joseph Kain
 * Adapted from corne_right.overlay copyright Pete Johanson
 *
 * SPDX-License-Identifier: MIT
 */

#include "kain.dtsi"

&default_transform {
    col-offset = <6>;
};


/*
 * This is a mirror of the left side as the board will be flipped and
 * align with the mirrored pins of the controller.
 */
&kscan0 {
    row-gpios
        = <&pro_micro 17 (GPIO_ACTIVE_HIGH | GPIO_PULL_DOWN)>
        , <&pro_micro 16 (GPIO_ACTIVE_HIGH | GPIO_PULL_DOWN)>
        , <&pro_micro 15 (GPIO_ACTIVE_HIGH | GPIO_PULL_DOWN)>
        , <&pro_micro 14 (GPIO_ACTIVE_HIGH | GPIO_PULL_DOWN)>
        ;

    col-gpios
        = <&pro_micro 13 GPIO_ACTIVE_HIGH>
        , <&pro_micro 8 GPIO_ACTIVE_HIGH>
        , <&pro_micro 9 GPIO_ACTIVE_HIGH>
        , <&pro_micro 10 GPIO_ACTIVE_HIGH>
        , <&pro_micro 11 GPIO_ACTIVE_HIGH>
        , <&pro_micro 12 GPIO_ACTIVE_HIGH>
        ;
};
