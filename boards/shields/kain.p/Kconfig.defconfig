## boards/shields/kain.p/Kconfig.defconfig
```kconfig
if SHIELD_KAIN_P_LEFT

config ZMK_KEYBOARD_NAME
    default "Kain_p"

config ZMK_SPLIT_ROLE_CENTRAL
    default y

endif

if SHIELD_KAIN_P_LEFT || SHIELD_KAIN_P_RIGHT

config ZMK_SPLIT
    default y

endif
```

## boards/shields/kain/Kconfig.defconfig
```kconfig
if SHIELD_KAIN_LEFT

config ZMK_KEYBOARD_NAME
    default "Kain"

config ZMK_SPLIT_ROLE_CENTRAL
    default y

endif

if SHIELD_KAIN_LEFT || SHIELD_KAIN_RIGHT

config ZMK_SPLIT
    default y

endif
```

## boards/shields/kain/Kconfig.shield
```kconfig
# Copyright (c) 2024 Joseph Kain
# Adapted from Corne's Kconfig.sheild copyright Pete Johanson
# SPDX-License-Identifier: MIT

config SHIELD_KAIN_LEFT
    def_bool $(shields_list_contains,kain_left)

config SHIELD_KAIN_RIGHT
    def_bool $(shields_list_contains,kain_right)
```

## boards/shields/kainp/Kconfig.defconfig
```kconfig
if SHIELD_KAINP_LEFT

config ZMK_KEYBOARD_NAME
    default "KainP"

config ZMK_SPLIT_ROLE_CENTRAL
    default y

endif

if SHIELD_KAINP_LEFT || SHIELD_KAINP_RIGHT

config ZMK_SPLIT
    default y

endif
```

## boards/shields/kainp/Kconfig.shield
```kconfig
# Copyright (c) 2024 Joseph Kain
# Adapted from Corne's Kconfig.sheild copyright Pete Johanson
# SPDX-License-Identifier: MIT

config SHIELD_KAINP_LEFT
    def_bool $(shields_list_contains,kainp_left)

config SHIELD_KAINP_RIGHT
    def_bool $(shields_list_contains,kainp_right)
```
